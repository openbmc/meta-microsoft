## conf/layer.conf
```bitbake
# We have a conf and classes directory, add to BBPATH
BBPATH .= ":${LAYERDIR}"

# We have recipes-* directories, add to BBFILE_
BBFILE_COLLECTIONS += "microsoft-layer"
BBFILE_PATTERN_microsoft-layer = ""
LAYERSERIES_COMPAT_microsoft-layer = "thud"
```
